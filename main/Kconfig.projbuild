## main/Kconfig.projbuild
```kconfig
menu "Example CoAP Client Configuration"

    config EXAMPLE_TARGET_DOMAIN_URI
        string "Target Uri"
        default "coaps://californium.eclipse.org"
        help
            Target uri for the example to use. Use coaps:// prefix for encrypted traffic
            using Pre-Shared Key (PSK) or Public Key Infrastructure (PKI).

    config EXAMPLE_COAP_PSK_KEY
        string "Preshared Key (PSK) to used in the connection to the CoAP server"
        depends on COAP_MBEDTLS_PSK
        default "sesame"
        help
            The Preshared Key to use to encrypt the communicatons. The same key must be
            used at both ends of the CoAP connection, and the CoaP client must request
            an URI prefixed with coaps:// instead of coap:// for DTLS to be used.

    config EXAMPLE_COAP_PSK_IDENTITY
        string "PSK Client identity (username)"
        depends on COAP_MBEDTLS_PSK
        default "password"
        help
            The identity (or username) to use to identify to the CoAP server which
            PSK key to use.

endmenu

menu "Example UART Configuration"

    config EXAMPLE_UART_PORT_NUM
        int "UART port number"
        range 0 2 if IDF_TARGET_ESP32
        range 0 1 if IDF_TARGET_ESP32S2
        default 2 if IDF_TARGET_ESP32
        default 1 if IDF_TARGET_ESP32S2
        help
            UART communication port number for the example.
            See UART documentation for available port numbers.

    config EXAMPLE_UART_BAUD_RATE
        int "UART communication speed"
        range 1200 115200
        default 115200
        help
            UART communication speed for Modbus example.

    config EXAMPLE_UART_RXD
        int "UART RXD pin number"
        range 0 34 if IDF_TARGET_ESP32
        range 0 46 if IDF_TARGET_ESP32S2
        default 5
        help
            GPIO number for UART RX pin. See UART documentation for more information
            about available pin numbers for UART.

    config EXAMPLE_UART_TXD
        int "UART TXD pin number"
        range 0 34 if IDF_TARGET_ESP32
        range 0 46 if IDF_TARGET_ESP32S2
        default 4
        help
            GPIO number for UART TX pin. See UART documentation for more information
            about available pin numbers for UART.

    config EXAMPLE_TASK_STACK_SIZE
        int "UART echo example task stack size"
        range 1024 16384
        default 2048
        help
            Defines stack size for UART echo example. Insufficient stack size can cause crash.

endmenu
```
